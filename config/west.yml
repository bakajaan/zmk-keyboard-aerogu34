## config/west.yml
```yaml
manifest:
  defaults:
    revision: main
  remotes:
    - name: cormoran
      url-base: https://github.com/cormoran
    - name: sekigon-gonnoc
      url-base: https://github.com/sekigon-gonnoc
    - name: caksoylar
      url-base: https://github.com/caksoylar
    - name: prospector
      url-base: https://github.com/t-ogura
    - name: bakajaan
      url-base: https://github.com/bakajaan
  # =====================================================================
  # 【SHAピン留め 2026-07-26】外部依存は動作確認済みのコミットに固定。
  # 上流ブランチの更新でビルドや挙動が勝手に変わるのを防ぐ。
  # 更新したいときは revision を新しいSHA（または一時的にブランチ名）に差し替える。
  # zmk-keymap-common は自分のリポジトリ（キーマップ編集を即反映させたい）のため main 追従のまま。
  # =====================================================================
  projects:
    # ZMK: cormoran fork, main+dya = ZMK main (Zephyr 4.1) base with DYA Studio RPC
    # (main+dya の 2026-07-25 時点 HEAD)
    - name: zmk
      remote: cormoran
      revision: e5c9b6915b56801193e359dd9bad4a167ce0d1b8
      import: app/west.yml
    # Trackball driver
    - name: zmk-driver-paw3222
      remote: sekigon-gonnoc
      revision: df652881be2520bde4f64ab6ca35e4c5708f4f9b
    # RGB LED widget (main supports Zephyr 4.1 / xiao_ble naming)
    - name: zmk-rgbled-widget
      remote: caksoylar
      revision: e6b467792a1dabef8cfa5c9fd26bfefc9c16662b
    # DYA Studio modules (main = v4-compatible)
    - name: zmk-module-ble-management
      remote: cormoran
      revision: 57738cc4fc6ba80e82a7ac57741a0339cb186cd4
    - name: zmk-module-battery-history
      remote: cormoran
      revision: 307755dd2ad4d320e14de162e8e5ef018f29d929
    - name: zmk-module-settings-rpc
      remote: cormoran
      revision: 78f86df9e6c5edaf57bef3ccbd7f360cfdf49291
    # DYA Studio トラブルシューティング機能
    - name: zmk-feature-device-info
      remote: cormoran
      revision: 8cedd2dd9f04e19ea5a17b94914dd47a09d8db11
    - name: zmk-feature-watchdog
      remote: cormoran
      revision: 84ad14c6c3645dc40b23f45d08ab45418655f912
      import: true
    - name: zmk-feature-kscan-diagnostics
      remote: cormoran
      revision: 1432f7fe0cfe903cd7d3c9931ae6bd6f2e1f328e
      import: true
    # BLEコントローラのアサート記録 (2026-07-27追加・jisaku_1と同SHA)
    # LL_ASSERT失敗を素のk_oops（PC/LRだけでシンボル解決不能）ではなく、
    # 発生元のソースファイル名と行番号としてウォッチドッグ記録に残す。
    - name: zmk-feature-ctlr-assert
      remote: bakajaan
      revision: 59d09925dc64bc3aaf30accfbbdf42ea922c0948
    - name: zmk-module-runtime-input-processor
      remote: cormoran
      revision: 43618985f8c9d5457cc333b7ca0733f2d361911e
    # カスタム設定 (設定タブの詳細設定 + os-detectionの依存 2026-07-26追加・jisaku_1と同SHA)
    - name: zmk-feature-custom-settings
      remote: cormoran
      revision: c6a7fef3a3be3d3ace5de9a4b0628c6418cd1f3f
    # 入力ストリーム (DYA Studioの打鍵ヒートマップ/Streamトグル用 2026-07-26追加)
    - name: zmk-feature-input-stream
      remote: cormoran
      revision: aeb015908a42a7615ccdccc7feb3a10d23132a71
    # 打鍵統計 (キーボード側に保存するヒートマップ + キーコード別集計 2026-07-27追加)
    # Studioを開いていない間の打鍵も記録され、再起動しても保持される。
    # 2026-07-27更新: カウンタの返し方を通知ストリームからカーソル方式の
    # ページング応答へ変更。通知はシステムワークキューを塞いでフリーズする。
    - name: zmk-feature-key-usage
      remote: bakajaan
      revision: bf52958c5ccce5aa12c6f112d5e03fd498b9c8a4
    # OS検出 + 接続先ごとのデフォルトレイヤー切替 (DYA Studio接続タブ用 2026-07-26追加)
    # os-detection は custom-settings に依存するが、上でSHA固定済みのため import は使わない
    - name: zmk-feature-os-detection
      remote: cormoran
      revision: 3052679f645b8fc1997275c2eaa6b86bdd55ca01
    # デフォルトレイヤー (2026-07-27 差し替え・jisaku_1と同SHA)
    # 旧: cormoran/zmk-feature-default-layer は「接続先ごと」だけの対応で、
    # OS別マッピングもStudio RPCも持たないため、DYA Studioの接続タブにある
    # 「OSごとのデフォルトレイヤー」が機能しなかった。
    # 新: bakajaan/zmk-feature-default-layer-os は同じKconfig名・同じ&df・
    # 同じsettingsキー(旧レコードは自動移行)のまま、OS別マッピングと
    # cormoran__default_layer サブシステムを追加したドロップイン置換。
    # 旧モジュールとは同居できない(compatible/Kconfigが衝突する)。
    # 【2026-07-27 修正】0f4cfd6d には CONFIG_ZMK_BLE_PROFILE_COUNT (存在しないKconfig)
    # を使うビルドエラーがあったため、43cba0469 (修正済みコミット) にSHAを更新。
    - name: zmk-feature-default-layer-os
      remote: bakajaan
      revision: 43cba0469c512d3d98f4bebca4a7edbbf7e7cc95
    # スレッドスタック使用量モニター + ログキャプチャ (DYA Studio Troubleshootingタブ用 2026-07-27追加・jisaku_1と同SHA)
    # cormoran__devtool サブシステム: スタックの高水位線・ログをリアルタイムで確認できる。
    # スタックオーバーフロー起因のウォッチドッグクラッシュの原因調査に有用。
    - name: zmk-module-devtool
      remote: cormoran
      revision: 9938a2c73c06d6e65ba2c0b68c9aa044a467eafc
    # 高速キーマップ読込 (DYA Studio 2026-07-27追加・jisaku_1と同SHA)
    # cormoran__fast_keymap サブシステム: フィンガープリントキャッシュにより
    # 2回目以降のキーマップ読込をほぼ即座に完了させる。
    - name: zmk-feature-fast-keymap
      remote: cormoran
      revision: 8dac76de0ba38588ba39ca498910e24f8332bc6b
    # Deadzone input processor
    - name: zmk-input-processor-deadzone
      remote: prospector
      revision: 7ae1bcb0d367ad00b7fa8836cf9a9b197d88e555
    # Prospector
    - name: prospector-zmk-module
      remote: prospector
      revision: 400a1743f56332a2e8344f74a572f62236cdfa29
      path: modules/prospector-zmk-module
    # 共通キーマップ定義(jisaku_1 / aerogu34で共有・main追従)
    - name: zmk-keymap-common
      remote: bakajaan
  self:
    path: config
```
